/*
 * Copyright (c) 2022 The ZMK Contributors
 *
 * SPDX-License-Identifier: MIT
 */

#include <behaviors.dtsi>
#include <dt-bindings/zmk/keys.h>
#include <dt-bindings/zmk/bt.h>

/ {
    keymap {
        compatible = "zmk,keymap";

        default_layer {
            label = "Qwety";
            bindings = <
                &bt BT_SEL 1
                &mo 1
            >;
        };

        bt_layer {
            label = "BLE"
            bindings = <
                &bt BT_CLR
                &none
            >;
        };
    };
};
